## drivers/gpu/drm/mediatek/Kconfig
```kconfig
# SPDX-License-Identifier: GPL-2.0-only
config DRM_MEDIATEK
	tristate "DRM Support for Mediatek SoCs"
	depends on DRM
	depends on ARCH_MEDIATEK || (ARM && COMPILE_TEST)
	depends on COMMON_CLK
	depends on HAVE_ARM_SMCCC
	depends on OF
	depends on MTK_MMSYS
	select DRM_KMS_HELPER
	select DRM_MIPI_DSI
	select DRM_PANEL
	select VIDEOMODE_HELPERS
	help
	  Choose this option if you have a Mediatek SoCs.
	  The module will be called mediatek-drm
	  This driver provides kernel mode setting and
	  buffer management to userspace.

config DRM_MEDIATEK_DP
	tristate "DRM DPTX Support for MediaTek SoCs"
	depends on DRM_MEDIATEK
	select DRM_DISPLAY_HELPER
	select DRM_DISPLAY_DP_HELPER
	select DRM_DP_AUX_BUS
	help
	  DRM/KMS Display Port driver for MediaTek SoCs.

config DRM_MEDIATEK_HDMI
	tristate "DRM HDMI Support for Mediatek SoCs"
	depends on DRM_MEDIATEK
	select SND_SOC_HDMI_CODEC if SND_SOC
	help
	  DRM/KMS HDMI driver for Mediatek SoCs

# --- merged from MiCode MTK_kernel_device_modules bsp-dali-v-oss ---
config DRM_MEDIATEK_CEC
	tristate "DRM CEC Support for Mediatek SoCs"
	help
	  DRM/KMS HDMI CEC driver for Mediatek SoCs.
	  Choose this option if you want to enable
	  CEC driver, and the DRM_MEDIATEK_HDMI
	  selects this config.


config DRM_MEDIATEK_CEC_SUSPEND_LOW_POWER
	tristate "DRM CEC SUSPEND LOW POWER Support for Mediatek SoCs"
	help
      This option enables support for DRM/KMS CEC
	  SUSPEND_LOW_POWER for Mediatek SoCs. When
	  this option is enabled, the CEC clock will
	  be disabled when the platform enters suspend
	  mode, reducing power consumption during suspend.


config DRM_MEDIATEK_HDMI_HDCP
	tristate "DRM HDMI HDCP Support for Mediatek SoCs"
	depends on OPTEE
	depends on DRM_MEDIATEK_HDMI
	help
	  DRM/KMS HDMI HDCP driver for Mediatek SoCs.
	  Choose this option if you want to enable
	  HDMI HDCP driver. This option enables the
	  DRM/KMS HDCP driver for Mediatek SoCs, providing
	  support for HDCP for Mediatek platforms.
```

## drivers/ufs/Kconfig
```kconfig
# SPDX-License-Identifier: GPL-2.0-only
#
# UFS subsystem configuration
#

menuconfig SCSI_UFSHCD
	tristate "Universal Flash Storage Controller"
	depends on SCSI && SCSI_DMA
	select PM_DEVFREQ
	select DEVFREQ_GOV_SIMPLE_ONDEMAND
	select NLS
	help
	  Enables support for UFS (Universal Flash Storage) host controllers.
	  A UFS host controller is an electronic component that is able to
	  communicate with a UFS card. UFS host controllers occur in
	  smartphones, laptops, digital cameras and also in cars.
	  The kernel module will be called ufshcd.

	  To compile this driver as a module, choose M here and read
	  <file:Documentation/scsi/ufs.rst>.
	  However, do not compile this as a module if your root file system
	  (the one containing the directory /) is located on a UFS device.

if SCSI_UFSHCD

source "drivers/ufs/core/Kconfig"

source "drivers/ufs/host/Kconfig"

endif

# --- merged from MiCode MTK_kernel_device_modules bsp-dali-v-oss ---
config SCSI_UFS_MEDIATEK_DBG
	tristate "Debugging facility for MediaTek UFS platforms"
	depends on SCSI_UFS_MEDIATEK
	help
	  This selects the debugging facility for Mediatek UFS platforms.
	  Provide UFS command history and connection to MediaTek Block IO
	  Tracer.

	  Select this if you want to enable above facilities.


config MTK_UFS_DEBUG
	bool "Support Mediatek UFS upstreaming features"
	depends on SCSI_UFSHCD
	help

config MTK_UFS_DEBUG_BUILD
	bool "Support Mediatek UFS facilities in debug build only"
	depends on SCSI_UFSHCD
	help
	  This selects the debugging facility for Mediatek UFS platforms
	  existed in debug build only.

	  Select this if you want to enable above facilities.
```
